/*
 * Ym2149Synth
 * http://trash80.com
 * Copyright (c) 2016 Timothy Lamb
 *
 * This file is part of Ym2149Synth.
 *
 * Ym2149Synth is free software: you can redistribute it and/or modify
 * it under the terms of the GNU General Public License as published by
 * the Free Software Foundation, either version 3 of the License, or
 * (at your option) any later version.
 *
 * Ym2149Synth is distributed in the hope that it will be useful,
 * but WITHOUT ANY WARRANTY; without even the implied warranty of
 * MERCHANTABILITY or FITNESS FOR A PARTICULAR PURPOSE.  See the
 * GNU General Public License for more details.
 *
 * You should have received a copy of the GNU General Public License
 * along with Foobar.  If not, see <http://www.gnu.org/licenses/>.
 *
 */

 #include "SynthVoice.h"

/*
 *
 * ~~~~~ BEHOLD ALLMIGHTY JAVASCRIPT FOR TABLE GENERATION. ~~~
 * Run in a browser console.
 *
 * For YM pitch "freqTable":
 * function nf(n) {return Math.round((2000000.0/((Math.pow(2,(((n) - 69)/12)) * 440.0)))/16);};var out = [];for(var i =0; i<128; i += 0.1) out.push(nf(i));copy(out.toString());console.log("Data in copybuffer. Array size is "+out.length);
 *
 * For SoftSynth pitch "softFreqTable":
 * function nf(n) {return Math.round((Math.pow(2,(((n) - 69)/12)) * 440.0) * (1.0/22050) * 100000);};var out = [];for(var i =0; i<128; i += 0.1) out.push(nf(i));copy(out.toString());console.log("Data in copybuffer. Array size is "+out.length);
 *
 * For Volume Envelope Table :
 * size=256;function nf(n) {return Math.round(Math.pow(n, 1.75) * 255);};var out = [];for(var i =0; i<size; i += 1) out.push(nf(i/size));copy(out.toString());console.log("Data in copybuffer. Array size is "+out.length);
 *
*/
//@TODO document this class
//@TODO resize these arrays to only include notes that are playable
const static uint16_t tableSize = 1281;
const static uint16_t freqTable[tableSize] = {
    15289,15201,15113,15026,14940,14854,14768,14683,14599,14515,14431,14348,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9
};

//@TODO fixed point, could be unsigned long
const static uint16_t softFreqTable[tableSize] = {
    37,37,38,38,38,38,38,39,39,39,39,40,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60271
};

const static uint8_t volumeEnvelopeTable[256] = {
0,0,0,0,0,0,0,0,1,1,1,1,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255
};

#define map_int16(x, in_min, in_max, out_min, out_max) ((x - in_min) * (out_max - out_min) / (in_max - in_min) + out_min)

void SynthVoice::begin(YM2149 * ym, uint8_t sy)
{
    Ym = ym;
    synth = sy;

    enableVoice = true;
    enableSoftsynth = true;

    Ym->setNoise(synth,0);
    Ym->setEnv(synth,0);
    volumeEnvelope.begin();
    pitchEnvelope.begin();

    volumeEnvelope.setShape(0x00);
    volumeEnvelope.setRange(0,31);
    volumeEnvelope.setLookupTable(volumeEnvelopeTable,255);

    pitchEnvelope.setShape(0x00);
    pitchEnvelope.setRange(0,0);

    synthType = 255;
    setSynthType(0);
}

void SynthVoice::updateSoftsynth()
{
    //@TODO optimize this, used fixed.h for fixed point math
    if(!enableSoftsynth || volume <= 0) {
        return;
    }

    softPhase += softIncrement;

    if(softPhase > 100000) softPhase -= 100000;
    if(softPhase < 0) softPhase += 100000;

    if(softPhase >= softWidth) {
        if(softWavPos) {
            softWavPos = 0;
            Ym->setVolume(synth,volume);
        }
    } else {
        if(!softWavPos) {
            softWavPos = 1;
            Ym->setVolume(synth,0);
        }
    }
}

void SynthVoice::updateEvents()
{
    //@TODO optimize this, used fixed.h for fixed point math
    uint16_t voiceF = currentNoteFreq+transpose;


    uint16_t envF = 0;
    uint16_t softF = 0;

    if(playing) {

        if(glideActive) {
            uint16_t destF  = noteFreq+transpose;
            glidePhase += glideIncrement;
            if(destF > voiceF) {
                voiceF += (glidePhase/1000);
                if(voiceF >= destF) {
                    lastNoteFreq = -1;
                    voiceF = destF;
                    currentNoteFreq = noteFreq;
                    glideActive = false;
                }
            } else {
                voiceF -= (glidePhase/1000);
                if(voiceF <= destF) {
                    lastNoteFreq = -1;
                    voiceF = destF;
                    currentNoteFreq = noteFreq;
                    glideActive = false;
                }
            }
        }

        if(bendWheel) {
            voiceF += bendWheel;
        }

        envF = softF = voiceF;

        if(vibratoAmount && currentNoteFreq) {
            vibratoPhase += vibratoIncrement;
            if(vibratoPhase > 10000) vibratoPhase -= 20000;
            if(vibratoPhase < -10000) vibratoPhase += 20000;
            voiceF += map_int16(((abs(vibratoPhase) * 2) - 10000), -10000, 10000, vibratoAmount*-1, vibratoAmount)/100;
        }

        if(pitchEnvAmount) {
            pitchEnvelope.update();
            uint16_t pitchEnvAmt = pitchEnvelope.read();
            voiceF += pitchEnvAmt;
        }

        if(voiceF != lastNoteFreq) {
            lastNoteFreq = voiceF;

            if(!voicePitchModOnly) {
                envF = softF = voiceF;
            }

            if(enableSoftsynth) {
                uint16_t sf = softF;
                if(enableSoftDetune) sf +=pwmFreq+softFreqDetune;
                if(sf>=tableSize) sf = tableSize-1;
                softIncrement = softFreqTable[sf];
            }

            if(enableEnv) {
                if(voicePitchModOnly) {
                    // Acid on the pitch Envelope
                    Ym->setTone(synth,freqTable[voiceF+(softFreqDetune>>1)]);
                    Ym->setTone(4,freqTable[envF+pwmFreq]);
                } else {
                    Ym->setTone(4,freqTable[voiceF+pwmFreq]);
                }
            } else if (enableVoice) {
                if(voicePitchModOnly) {
                    Ym->setTone(synth,freqTable[voiceF+(softFreqDetune>>1)]);
                } else {
                    Ym->setTone(synth,freqTable[voiceF]);
                }
            }
            if (enableNoise) {
                Ym->setTone(3,0x1F - (((uint8_t)(voiceF/10))>>2));
            }
        }

        if(volumeEnvelope.update()) {
            volume = volumeEnvelope.read();
            if(volume == 0 && volumeEnvelope.getShape() & 0x80) {
                playing = false;
            }
            if(!enableSoftsynth)
                Ym->setVolume(synth,volume);
        }

        if(noiseDelay && !noiseDelayTriggered) {
            noiseDelayPhase += 1;
            if(noiseDelayPhase >= noiseDelayIncrement) {
                noiseDelayPhase = 0;
                noiseDelayTriggered = true;
                if(!enableNoise) {
                    Ym->setNoise(synth,2);
                } else {
                    Ym->setNoise(synth,0);
                }
            }
        }
    }
}

void SynthVoice::playNote(uint8_t n, uint8_t v)
{
    //@TODO refactor this
    //@TODO use a new note buffer class for handling monophonic note behavior
    if(v) {
        velocity = v;
        note     = n;
        noteFreq = ((uint16_t)n)*10;


        if(playing == false) {
            volumeEnvelope.reset();
            volumeEnvelope.setRange(0,v>>3);
            currentNoteFreq = noteFreq;
            volume = -1;

            glidePhase = 0;
            glideActive= false;
        } else {
            if(glide) {
                if(glideActive) currentNoteFreq = lastNoteFreq;
                glideActive = true;
                glidePhase = 0;

                glideIncrement = (((uint32_t)abs(noteFreq - currentNoteFreq))*10000)/glide;
                if(!glideIncrement) glideIncrement = 1;
            } else {
                glideIncrement = 0;
                currentNoteFreq = noteFreq;
                glidePhase = 0;
                glideActive= false;
            }
        }

        pitchEnvelope.reset();

        if(softIncrement > 1) softIncrement = 1;
        if(softIncrement < 0) softIncrement = 0;

        if(!enableVoice) {
            Ym->setNote(synth,255);
        }

        if(enableNoise) {
            Ym->setNoise(synth,1);
        } else {
            noiseDelayTriggered = false;
            enableNoise = false;
            Ym->setNoise(synth,0);
        }
        noiseDelayPhase = 0;

        if(enableEnv) {
            Ym->setEnv(synth,1);
            Ym->setEnvShape(0,0,0,0);
            if(envType == 1) {
                Ym->setEnvShape(1,0,0,0);
            } else {
                Ym->setEnvShape(1,0,1,0);
            }
        }

        playing = true;
        lastNoteFreq = 0;
    } else if(n == note) {
        playing = false;
        volume = 0;
        if(enableEnv) {
            Ym->setEnv(synth,0);
        }
        Ym->setVolume(synth,0);
    }
}

void SynthVoice::setPitchbend(int v)
{
    // Plus / minus 2 notes (since we have glide)
    // v == -0x2000 to 0x2000
    bendWheel = (v>>2)/100;
}

void SynthVoice::setGlide(uint8_t v)
{
    //unsigned int ms = map(v, 0, 127, 0, 1000);
    glide = v;
    glide<<=6;
}

void SynthVoice::setVolumeEnvShape(uint8_t v)
{
    if(v == 64) v = 65;
    volumeEnvelope.setShape(v);
}

void SynthVoice::setPitchEnvShape(uint8_t v)
{
    pitchEnvelope.setShape(v);
}

void SynthVoice::setPitchEnvAmount(uint8_t v)
{
    pitchEnvAmount = v;
    pitchEnvAmount*= 10;
    pitchEnvelope.setRange(0,pitchEnvAmount);
}

void SynthVoice::setVibratoAmount(uint8_t v)
{
    vibratoAmount = v*100;
}

void SynthVoice::setVibratoFreq(uint8_t v)
{
    unsigned int ms = (pow(8000.0f,1.0f - ((float)v)/127.0f)) + 5;
    vibratoIncrement = (1.0f/ms)*10000;
}

void SynthVoice::setPwmFreq(uint8_t v)
{
    pwmFreq = v;

    if(synthType == 6) {
        softWidth = (((float)(pwmFreq)/255) + 0.5) * 100000;
    }
    if(playing) {
        lastNoteFreq = 0;
    }
}

void SynthVoice::setSoftDetune(uint8_t v)
{
    softFreqDetune = v;
    softFreqDetune *= 10;
    if(playing) {
        lastNoteFreq = 0;
    }
}

void SynthVoice::setNoiseDelay(uint8_t v)
{
    noiseDelay = v;
    v = 127 - v;
    noiseDelayIncrement = v<<1;
}

void SynthVoice::setTranspose(uint8_t v)
{
    if(!v) v = 64;
    transpose = (((int)v) - 64) * 10;
}

void SynthVoice::setSynthType(uint8_t v)
{
    if(v == synthType) return;

    synthType = v;

    if(enableNoise) Ym->setNoise(synth,0);
    if(enableEnv) Ym->setEnv(synth,0);

    enableVoice = false;
    enableSoftsynth = false;
    enableEnv   = false;
    envType     = 0;
    enableNoise = false;
    enableSoftDetune = false;
    voicePitchModOnly = false;

    switch(synthType)
    {
        case 0:
            enableVoice = true;
        break;
        case 1:
            voicePitchModOnly = true;
            enableVoice = true;
            enableEnv   = true;
            envType     = 1;
        break;
        case 2:
            voicePitchModOnly = true;
            enableVoice = true;
            enableEnv   = true;
            envType     = 2;
        break;
        case 3:
            enableVoice = false;
            enableEnv   = true;
            envType     = 2;
        break;
        case 4:
            enableVoice = false;
            enableEnv   = true;
            envType     = 1;
        break;
        case 5:
            enableVoice = true;
            enableSoftsynth = true;
            enableSoftDetune  = true;
            softWidth = 50000;
        break;
        case 6:
            enableVoice = true;
            enableSoftsynth = true;
            voicePitchModOnly = true;
            enableSoftDetune  = false;
            softWidth = (((float)(pwmFreq)/255) + 0.5) * 100000;
        break;
        case 7:
            enableNoise = true;
        break;
        default:
            enableVoice = true;
        break;
    }
    if(playing) {
        lastNoteFreq = 0;
        playing = false;
        playNote(note, velocity);
    }
}
